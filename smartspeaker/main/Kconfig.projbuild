## smartspeaker/main/Kconfig.projbuild
```kconfig
menu "Example configuration"

    config SNTP_TIME_SERVER
        string "SNTP server name"
        default "pool.ntp.org"
        help
            Hostname of the main SNTP server.

    choice SNTP_TIME_SYNC_METHOD
        prompt "Time synchronization method"
        default SNTP_TIME_SYNC_METHOD_IMMED
        help
            Time synchronization method.

        config SNTP_TIME_SYNC_METHOD_IMMED
            bool "update time immediately when received"
        config SNTP_TIME_SYNC_METHOD_SMOOTH
            bool "update time with smooth method (adjtime)"
        config SNTP_TIME_SYNC_METHOD_CUSTOM
            bool "custom implementation"
    endchoice

    config EXAMPLE_I2C_ADDR
        hex "I2C address of PCF8574"
        default 0x27

    config EXAMPLE_I2C_MASTER_SCL
        int "SCL GPIO Number"
        default 5 if IDF_TARGET_ESP8266
        default 6 if IDF_TARGET_ESP32C3
        default 23 if IDF_TARGET_ESP32 || IDF_TARGET_ESP32S2 || IDF_TARGET_ESP32S3
        help
            GPIO number for I2C Master clock line.

    config EXAMPLE_I2C_MASTER_SDA
        int "SDA GPIO Number"
        default 4 if IDF_TARGET_ESP8266
        default 5 if IDF_TARGET_ESP32C3
        default 18 if IDF_TARGET_ESP32 || IDF_TARGET_ESP32S2 || IDF_TARGET_ESP32S3
        help
            GPIO number for I2C Master data line.
            
endmenu
```
